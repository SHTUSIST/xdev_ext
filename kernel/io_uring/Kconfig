## kernel/io_uring/Kconfig
```kconfig
# SPDX-License-Identifier: GPL-2.0-only
#
# io_uring configuration
#

config IO_URING_ZCRX
	def_bool y
	depends on IO_URING
	depends on PAGE_POOL
	depends on INET
	depends on NET_RX_BUSY_POLL

config IO_URING_XDEV_EXT_BPF_POLICY
	bool "XDEV_EXT BPF struct_ops policy"
	default n
	depends on IO_URING
	depends on BPF_SYSCALL
	depends on BPF_JIT
	depends on DEBUG_INFO_BTF
	help
	  Enable the built-in XDEV_EXT policy boundary.  One struct_ops plugin can be
	  attached per backend.  Its mandatory dispatch and complete callbacks
	  each record exactly one bounded plan through the phase-specific XDEV_EXT
	  kfunc collection.  Backend admission, descriptor construction,
	  submission, completion, cancellation, and rollback remain in C.

config IO_URING_XDEV_EXT_IAA
	bool "XDEV_EXT Intel IAA compression operations"
	default n
	depends on IO_URING
	depends on CRYPTO
	select CRYPTO_ACOMP2
	help
	  Enable asynchronous IAA compress and decompress unified operations over
	  registered XDEV_EXT UMEM.  The implementation allocates the deflate-iaa
	  transform lazily, so an IAA provider loaded after ring creation remains
	  usable.  A provider or device is not required at build time.

config IO_URING_XDEV_EXT_AFXDP_COPY
	bool "XDEV_EXT AF_XDP copy-mode send"
	default n
	depends on IO_URING
	depends on XDP_SOCKETS
	help
	  Enable the unified SEND path for a bound, TX-capable AF_XDP socket.
	  The kernel copies one XSK UMEM frame into an skb through
	  xsk_kernel_xmit(); this does not make the kernel a producer of the
	  userspace AF_XDP TX ring.  Registered io_uring UMEM remains rejected
	  because it has no pool alias or lifetime contract with the XSK UMEM.

config XDEV_EXT_MECH
	bool "XDEV_EXT eBPF mechanism layer"
	default n
	depends on IO_URING_XDEV_EXT_BPF_POLICY && XDP_SOCKETS
	select CRC32
	help
	  Enable in-kernel XDEV_EXT mechanism sessions, created through
	  IORING_REGISTER_XDEV_EXT_MECH.  One struct_ops type per device class
	  (NVMe, AF_XDP, copy engine) lets eBPF fill native descriptors in a
	  bounded scratch area and interpret native completions.  C validates
	  every descriptor field and keeps admission, DMA mapping, queues,
	  doorbells, frame ownership and teardown; a session fails closed when
	  a program is missing or misbehaves.

config XDEV_EXT_MECH_CE
	bool "XDEV_EXT mechanism copy-engine class"
	default n
	depends on XDEV_EXT_MECH
	help
	  Enable the copy-engine class of the mechanism layer and its backend
	  registration interface for GPU copy-engine drivers.  A transfer whose
	  outcome is ambiguous sequesters its frames for good.

config XDEV_EXT_MECH_DMA
	bool "XDEV_EXT mechanism registered DMA provider class"
	default n
	depends on XDEV_EXT_MECH
	help
	  Enable bounded window-to-host-pool copy plans over dynamically
	  registered providers. Drivers own mappings and native completion;
	  C validates plans and quarantines ambiguous submitted transfers.

config XDEV_EXT_MECH_C_REFERENCE
	bool "XDEV_EXT mechanism C reference callbacks"
	default n
	depends on XDEV_EXT_MECH
	help
	  Measurement builds only.  Allow a class's callbacks to be served by
	  C functions with the same logic as the eBPF programs, so the cost
	  of the language can be measured apart from the cost of the path.

config XDEV_EXT_MECH_ZEROCOPY
	bool "XDEV_EXT mechanism strict NVMe SGL data path"
	default y
	depends on XDEV_EXT_MECH
	help
	  Require a PCI NVMe controller with data SGL support for mechanism
	  sessions. Submit the original UMEM pages with SGLs, including single
	  segment requests; never fall back to PRP or kernel bounce buffers.
	  Ordinary NVMe requests and admin queues keep their normal behavior.
	  Disable this option to build the legacy PRP-compatible path. AF_XDP
	  driver zero-copy is selected separately when binding the socket.

config XDEV_EXT_MECH_KVM_BOUNCE
	bool "XDEV_EXT mechanism NVMe bounce fallback for KVM tests"
	default n
	depends on XDEV_EXT_MECH && !XDEV_EXT_MECH_ZEROCOPY
	help
	  KVM test builds only.  When the emulated NVMe controller cannot take
	  the batch frames as scatter-gather segments, copy them into kernel
	  pages before submission instead of failing the batch.  Results from
	  such a build make no claim about avoided copies.

config XDEV_EXT_MECH_IAA
 bool "XDEV_EXT mechanism variable-length IAA transform class"
 default n
 depends on XDEV_EXT_MECH && CRYPTO
 select CRYPTO_ACOMP2
 help
   Bounded dual-lease compression/decompression through CryptoAPI acomp.
   Hardware uses deflate-iaa; software tests must explicitly request software.

config XDEV_EXT_MECH_SOCKET
	bool "XDEV_EXT mechanism connected UDP compatibility sink"
	default n
	depends on XDEV_EXT_MECH && INET
	help
	  Send a bounded batch as one connected IPv4/IPv6 UDP datagram through
	  the ordinary kernel socket path. This path performs native socket
	  payload copying and completes locally; it provides no remote ACK.
```

## src/core/io_uring/Kconfig
```kconfig
# SPDX-License-Identifier: GPL-2.0-only
#
# io_uring configuration
#

config IO_URING_ZCRX
	def_bool y
	depends on IO_URING
	depends on PAGE_POOL
	depends on INET
	depends on NET_RX_BUSY_POLL

config IO_URING_XDEV_EXT_BPF_POLICY
	bool "XDEV_EXT BPF struct_ops policy"
	default n
	depends on IO_URING
	depends on BPF_SYSCALL
	depends on BPF_JIT
	depends on DEBUG_INFO_BTF
	help
	  Enable the built-in XDEV_EXT policy boundary.  One struct_ops plugin can be
	  attached per backend.  Its mandatory dispatch and complete callbacks
	  each record exactly one bounded plan through the phase-specific XDEV_EXT
	  kfunc collection.  Backend admission, descriptor construction,
	  submission, completion, cancellation, and rollback remain in C.

config IO_URING_XDEV_EXT_IAA
	bool "XDEV_EXT Intel IAA compression operations"
	default n
	depends on IO_URING
	depends on CRYPTO
	select CRYPTO_ACOMP2
	help
	  Enable asynchronous IAA compress and decompress unified operations over
	  registered XDEV_EXT UMEM.  The acomp driver is selected by the
	  xdev_ext_iaa.acomp_driver parameter (default deflate-iaa; the software
	  deflate-generic driver is for functional tests).  One transform is
	  looked up on first use and shared by later requests; a failed lookup
	  is retried by the next request, so a provider loaded after ring
	  creation remains usable, and the transform is released after a
	  provider failure, a selection change or five idle seconds.
	  xdev_ext_iaa.acomp_served counts requests per actual serving driver.
	  deflate-iaa fails a request whose buffers map to more than one DMA
	  segment, and overlaps requests only in its async_irq sync_mode.  A
	  provider or device is not required at build time.

	  This option also changes legacy UMEM READ: io_uring/Makefile defines
	  XDEV_EXT_LIFECYCLE_SM for every io_uring object, so unified_ops
	  completes UMEM READ asynchronously through the per-frame state words
	  of xdev_ext_frame_sm.h instead of synchronously.  Each legacy window
	  must then resolve to one owned frame and a producer must start at a
	  frame boundary.  These state words carry no generation token; the
	  mechanism session lifecycle is a separate implementation.

config IO_URING_XDEV_EXT_AFXDP_COPY
	bool "XDEV_EXT AF_XDP copy-mode send"
	default n
	depends on IO_URING
	depends on XDP_SOCKETS
	help
	  Enable the unified SEND path for a bound, TX-capable AF_XDP socket.
	  The kernel copies one XSK UMEM frame into an skb through
	  xsk_kernel_xmit(); this does not make the kernel a producer of the
	  userspace AF_XDP TX ring.  Registered io_uring UMEM remains rejected
	  because it has no pool alias or lifetime contract with the XSK UMEM.

config XDEV_EXT_MECH
	bool "XDEV_EXT eBPF mechanism layer"
	default n
	depends on IO_URING_XDEV_EXT_BPF_POLICY && XDP_SOCKETS
	select CRC32
	help
	  Enable in-kernel XDEV_EXT mechanism sessions, created through
	  IORING_REGISTER_XDEV_EXT_MECH.  One struct_ops type per device class
	  (NVMe, AF_XDP, copy engine) lets eBPF fill native descriptors in a
	  bounded scratch area and interpret native completions.  C validates
	  every descriptor field and keeps admission, DMA mapping, queues,
	  doorbells, frame ownership and teardown; a session fails closed when
	  a program is missing or misbehaves.

config XDEV_EXT_MECH_CE
	bool "XDEV_EXT mechanism copy-engine class"
	default n
	depends on XDEV_EXT_MECH
	help
	  Enable the copy-engine class of the mechanism layer and its backend
	  registration interface for GPU copy-engine drivers.  A transfer whose
	  outcome is ambiguous sequesters its frames for good.

config XDEV_EXT_MECH_DMA
	bool "XDEV_EXT mechanism registered DMA provider class"
	default n
	depends on XDEV_EXT_MECH
	help
	  Enable bounded window-to-host-pool copy plans over dynamically
	  registered providers. Drivers own mappings and native completion;
	  C validates plans and quarantines ambiguous submitted transfers.

config XDEV_EXT_MECH_XDOMAIN
	tristate "XDEV_EXT mechanism Thunderbolt/USB4 host-to-host class"
	default n
	depends on XDEV_EXT_MECH && USB4 && PCI_P2PDMA
	help
	  Enable the XDOMAIN service and class for device-memory payload
	  transport between Thunderbolt/USB4 hosts. Uses the exported
	  XDomain service API and opt-in NHI software retirement for rings
	  whose native completion is unknown. Payload is not staged in host
	  memory; CREATE refuses an allocation the requester cannot reach
	  without a bounce. PCI_P2PDMA requires ZONE_DEVICE and memory hotplug.
	  This option alone does not establish physical DMA or performance.

config XDEV_EXT_MECH_C_REFERENCE
	bool "XDEV_EXT mechanism C reference callbacks"
	default n
	depends on XDEV_EXT_MECH
	help
	  Measurement builds only.  Allow a class's callbacks to be served by
	  C functions with the same logic as the eBPF programs, so the cost
	  of the language can be measured apart from the cost of the path.

config XDEV_EXT_MECH_ZEROCOPY
	bool "XDEV_EXT mechanism strict NVMe SGL data path"
	default y
	depends on XDEV_EXT_MECH
	help
	  Require a PCI NVMe controller with data SGL support for mechanism
	  sessions. Submit the original UMEM pages with SGLs, including single
	  segment requests; never fall back to PRP or kernel bounce buffers.
	  Ordinary NVMe requests and admin queues keep their normal behavior.
	  Disable this option to build the legacy PRP-compatible path. AF_XDP
	  driver zero-copy is selected separately when binding the socket.

config XDEV_EXT_MECH_KVM_BOUNCE
	bool "XDEV_EXT mechanism NVMe bounce fallback for KVM tests"
	default n
	depends on XDEV_EXT_MECH && !XDEV_EXT_MECH_ZEROCOPY
	help
	  KVM test builds only.  When the emulated NVMe controller cannot take
	  the batch frames as scatter-gather segments, copy them into kernel
	  pages before submission instead of failing the batch.  Results from
	  such a build make no claim about avoided copies.

config XDEV_EXT_MECH_IAA
 bool "XDEV_EXT mechanism variable-length IAA transform class"
 default n
 depends on XDEV_EXT_MECH && CRYPTO
 select CRYPTO_ACOMP2
 help
   Bounded dual-lease compression/decompression through CryptoAPI acomp.
   Hardware uses deflate-iaa; software tests must explicitly request software.
   A hardware stage is created only when every source frame window and each
   request's whole output window is one physically contiguous range, because
   deflate-iaa refuses multi-segment buffers; set the iaa_crypto sync_mode
   to async_irq, otherwise each request polls inside submission.

config XDEV_EXT_MECH_SOCKET
	bool "XDEV_EXT mechanism connected UDP compatibility sink"
	default n
	depends on XDEV_EXT_MECH && INET
	help
	  Send a bounded batch as one connected IPv4/IPv6 UDP datagram through
	  the ordinary kernel socket path. This path performs native socket
	  payload copying and completes locally; it provides no remote ACK.

config XDEV_EXT_MECH_CPU
 bool "XDEV_EXT bounded in-frame CPU transforms"
 default n
 depends on XDEV_EXT_MECH && CRYPTO
 select CRYPTO_ACOMP2
 select CRYPTO_DEFLATE
 select CRYPTO_LIB_SHA256
 select XXHASH
 help
   Fixed CRC32C, parse and digest transforms use the registered frame CPU
   mapping. Synchronous raw deflate/inflate use reserved same-pool output.
```

## src/network/net/xdp/Kconfig
```kconfig
# SPDX-License-Identifier: GPL-2.0-only
config XDP_SOCKETS
	bool "XDP sockets"
	depends on BPF_SYSCALL
	default n
	help
	  XDP sockets allows a channel between XDP programs and
	  userspace applications.

config XDP_SOCKETS_DIAG
	tristate "XDP sockets: monitoring interface"
	depends on XDP_SOCKETS
	default n
	help
	  Support for PF_XDP sockets monitoring interface used by the ss tool.
	  If unsure, say Y.

config XDP_SOCKETS_XDEV_EXT_POLICY
	bool "XDEV_EXT policy for AF_XDP TX and RX rings"
	depends on XDP_SOCKETS
	depends on IO_URING_XDEV_EXT_BPF_POLICY
	default n
	help
	  Interpose the XDEV_EXT AF_XDP policy at the kernel consumer boundary of
	  userspace TX rings. A bounded per-pool journal pins the exact policy
	  generation until ownership retirement and publishes completion entries
	  only after the matching policy completion callback. RX-aware plugins may
	  also opt in at registration. RX dispatch happens once per complete packet
	  and completion follows the RX-ring publication release-store.
```
